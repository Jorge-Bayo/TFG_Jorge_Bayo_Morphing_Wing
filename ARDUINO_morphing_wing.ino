#include <Servo.h>
#include <SPI.h>
#include <Wire.h>
#include <Adafruit_GFX.h>      // Librería base de gráficos (puntos, líneas, etc.)
#include <Adafruit_SH110X.h>   // Librería específica para tu chip SH1107

//LOGOS E IMAGENES PARA PNTALLA DE INICIO
const unsigned char LOGO_EUPT [] PROGMEM = {
	0x00, 0x00, 0x00, 0x00, 0x00, 0x00, 0x00, 0x00, 0x00, 0x00, 0x00, 0x00, 0x00, 0x00, 0x00, 0x00, 
	0x00, 0x00, 0x00, 0x00, 0x00, 0x00, 0x00, 0x00, 0x00, 0x00, 0x00, 0x00, 0x00, 0x00, 0x00, 0x00, 
	0x00, 0x00, 0x00, 0x00, 0x00, 0x00, 0x00, 0x00, 0x00, 0x00, 0x00, 0x00, 0x00, 0x00, 0x00, 0x00, 
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	0x00, 0x00, 0x00, 0x00, 0x00, 0x00, 0x00, 0x00, 0x00, 0x00, 0x00, 0x00, 0x00, 0x00, 0x00, 0x00
};
const int LOGO_EUPTallArray_LEN = 1;
const unsigned char* LOGO_EUPTallArray[1] = {
	LOGO_EUPT
};
const unsigned char IM_FORMA_PERFIL [] PROGMEM = {
	0x00, 0x00, 0x00, 0x00, 0x00, 0x00, 0x00, 0x00, 0x00, 0x00, 0x00, 0x00, 0x00, 0x00, 0x00, 0x00, 
	0x00, 0x00, 0x00, 0x00, 0x00, 0x00, 0x00, 0x00, 0x00, 0x00, 0x00, 0x00, 0x00, 0x00, 0x00, 0x00, 
	0x00, 0x00, 0x00, 0x00, 0x00, 0x00, 0x00, 0x00, 0x00, 0x00, 0x00, 0x00, 0x00, 0x00, 0x00, 0x00, 
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	0x00, 0x00, 0x00, 0x00, 0x00, 0x00, 0x00, 0x00, 0x00, 0x00, 0x00, 0x00, 0x00, 0x00, 0x00, 0x00
};
const int IM_allArray_LEN = 1;
const unsigned char* IM_allArray[1] = {
	IM_FORMA_PERFIL
};

// DEFINIMOS ANCHO Y ALTO PANTALLA OLED
#define ANCHO 128
#define ALTO 64

Adafruit_SH1107 display = Adafruit_SH1107(64, 128, &Wire); //CONFIGURO LA PANTALLA
Servo servo1;  //CREO LOS DOS SERVOS
Servo servo2;

int potpin = 0;  //PIN UTILIZADO PARA EL POTENCIOMETRO

//DEFINO VARIABLES GOLBALES
int val;    
int val1;
int val2;
int lift_raw;
float lift, drag;
int drag_raw;
float COEF_FLEX = 0.0;
float ultimo_COEF_FLEX = -1.0; // Para detectar cambios reales
int porcentage;

// Defino Parámetros físicos de la viga (Perfil)
const float L1 = 7.8; 
const float L2 = 9.0;
const float L3 = 3.2;
const float total_length = L1 + L2 + L3; // 20 cm

// VARIABLES DE UBICACIÓN Y ESCALA
// Modifica estos valores para mover y redimensionar el dibujo
const int origenX = 50;       // Posición horizontal donde empieza la viga (en píxeles)
const int origenY = 25;       // Posición vertical del nivel 'cero' de la viga (en píxeles)
const int anchoGrafica = 70;  // Cuántos píxeles de ancho ocupará la viga en total
const float escalaY = 9.0;    // Multiplicador de deflexión (bájalo si se sale de la pantalla)

//FUNCION PARA MOSTRAR LAS IMAGENES DE INICIO
void mostrarEscena(const unsigned char* bitmap) {
  display.clearDisplay();
  
  // 1. Dibujamos el logo de fondo
  display.drawBitmap(0, 0, bitmap, ANCHO, ALTO, SH110X_WHITE);
  
  // 2. Superponemos el título con un fondo negro para legibilidad
  // Dibujamos un rectángulo negro pequeño en la base
  display.fillRect(0, 50, 128, 14, SH110X_BLACK);  
  display.setTextSize(1);
  display.setTextColor(SH110X_WHITE);
  display.setCursor(30, 1); // Centrado aproximado
  display.print("MORPHING WING");
  // Opcional: Una línea decorativa debajo del título
  display.drawFastHLine(1, 10, 128, SH110X_WHITE);  
  display.display();
}


//FUNCION PARA OBTENER PARAMETROS DE LA VIGA
float obtenerYViga(float x, float f_factor) {
  if (x < L1) {
    return 0.0;
  }
  else if (x >= L1 && x < (L1 + L2)) {
    float x2_prime = x - L1;
    return -f_factor * pow(x2_prime, 2) / 2.0;
  }
  else {
    float x2_max = L2;
    float y_at_end_L2 = -f_factor * pow(x2_max, 2) / 2.0;
    float dzdx_at_end_L2 = -f_factor * x2_max;
    float x3_prime = x - L1 - L2;
    return y_at_end_L2 + (dzdx_at_end_L2 * x3_prime);
  }
}

void setup() {

	delay(1000);   				// ESPERO HASTA LA ESTABILIZACIÓN
	servo1.attach(9);			//ESTABLEZCO LOS PINES DE SEÑAL DE LOS SERVOS
  servo2.attach(10);
	servo1.write(93);    	// MUEVO LOS SERVOS A LA POSICION INICIAL
  servo2.write(93);

  if (!display.begin(0x3C, true)) while (1); 		//SI PANTALLA FALLA SE PARA EL PROGRAMA
  display.setRotation(1);
	

  // Escena 1: Logo Universidad
  mostrarEscena(LOGO_EUPT);
  delay(3000); // Espera 3 segundos
  
  // Escena 2: Isotipo Wing
  mostrarEscena(IM_FORMA_PERFIL);
  delay(3000); // Espera 3 segundos

	display.clearDisplay(); // Limpiar antes de pasar al loop

}

void loop() {

  val = analogRead(potpin);            	//LEO EL VALOR DEL POTENCIOMETRO 0 a 1023
	lift_raw = analogRead(2);
  val1 = map(val, 0, 1023, 93, 112);    //LO ESCALO A GRADOS (EL SERVO EMPIEZA EN 93 GRADOS SIEMPRE) 
  val2 = map(val, 0, 1023, 93, 74);
	lift = ((float)lift_raw / 1023.0) * 5 * 1.20 ;
	COEF_FLEX = ((float)val / 1023.0) * 0.03;		//AJUSTO EL VALOR DEL POTENCIOMETRO PARA USARLO COMO COEF DE FLEXION
	porcentage = COEF_FLEX*3334;								//LO PASO A 0-100 PARA REPRESENTACIONES
  servo1.write(val1);                  				// MUEVO LOS SERVOS A LA POSICION 
  servo2.write(val2); 
  delay(15);

  // ACTUALIZACIÓN DE LA PANTALLA
  display.clearDisplay(); // Borramos el dibujo anterior
  
  // Dibujar título fijo arriba
  display.setTextSize(1);
  display.setTextColor(SH110X_WHITE);
  display.setCursor(0, 0);
  display.println("CONTROL MORPHING WING");
  display.drawFastHLine(0, 10, 128, SH110X_WHITE); // Línea divisoria


	//DUBUJO CUERDA DEL PERFIL FLEXIONANDO PARA ELLO:
	// Recorremos los píxeles horizontales asignados a la gráfica
  for (int i = 0; i < anchoGrafica; i++) {
    
    // Proporción actual del dibujo (de 0.0 a 1.0)
    float proporcion = (float)i / (float)(anchoGrafica - 1);
    
    // 1. Convertimos la posición del píxel a centímetros reales de la viga
    float x_cm = proporcion * total_length;
    
    // 2. Calculamos la deflexión en cm usando el factor actual del potenciómetro
    float y_cm = obtenerYViga(x_cm, COEF_FLEX);
    
    // 3. Escalamos y ubicamos en la pantalla usando los nuevos parámetros
    int pixel_x = origenX + i;
    int pixel_y = origenY - (int)(y_cm * escalaY);
    
    // Dibujamos el píxel comprobando que no se salga de la sección gráfica asignada
    if (pixel_y >= 0 && pixel_y < 64 && pixel_x < 128) {
      display.writePixel(pixel_x, pixel_y, SH110X_WHITE);
    }
	}	

  // MOSTRAR EL VALOR LEIDO DE LIFT (Texto Grande)
  display.setCursor(10, 35);
  display.setTextSize(2); 
  display.print(lift);
  
  // Dibujar una barra de progreso inferior
  int largoBarra = map(porcentage, 0, 100, 0, 128);
  display.fillRect(0, 55, largoBarra, 8, SH110X_WHITE);
  
  // Enviar todo el dibujo a la pantalla física
  display.display();  
  delay(25);
}
